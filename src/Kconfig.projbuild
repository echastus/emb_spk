## src/Kconfig.projbuild
```kconfig
menu "A2DP Configuration"

    choice EXAMPLE_A2DP_SINK_OUTPUT
        prompt "A2DP Sink Output"
        default EXAMPLE_A2DP_SINK_OUTPUT_EXTERNAL_I2S
        help
            Select to use Internal DAC or external I2S driver

        config EXAMPLE_A2DP_SINK_OUTPUT_INTERNAL_DAC
            bool "Internal DAC"
            help
                Select this to use Internal DAC sink output

        config EXAMPLE_A2DP_SINK_OUTPUT_EXTERNAL_I2S
            bool "External I2S Codec"
            help
                Select this to use External I2S sink output

    endchoice

    config EXAMPLE_I2S_LRCK_PIN
        int "I2S LRCK (WS) GPIO"
        default 22
        depends on EXAMPLE_A2DP_SINK_OUTPUT_EXTERNAL_I2S
        help
            GPIO number to use for I2S LRCK(WS) Driver.

    config EXAMPLE_I2S_BCK_PIN
        int "I2S BCK GPIO"
        default 26
        depends on EXAMPLE_A2DP_SINK_OUTPUT_EXTERNAL_I2S
        help
            GPIO number to use for I2S BCK Driver.

    config EXAMPLE_I2S_DATA_PIN
        int "I2S DATA GPIO"
        default 25
        depends on EXAMPLE_A2DP_SINK_OUTPUT_EXTERNAL_I2S
        help
            GPIO number to use for I2S Data Driver.

endmenu

menu "I2C Configuration"

    config I2C_MASTER_SCL
        int "SCL GPIO Num"
        default 6 if IDF_TARGET_ESP32C3
        default 19 if IDF_TARGET_ESP32 || IDF_TARGET_ESP32S2 || IDF_TARGET_ESP32S3
        help
            GPIO number for I2C Master clock line.

    config I2C_MASTER_SDA
        int "SDA GPIO Num"
        default 5 if IDF_TARGET_ESP32C3
        default 18 if IDF_TARGET_ESP32 || IDF_TARGET_ESP32S2 || IDF_TARGET_ESP32S3
        help
            GPIO number for I2C Master data line.

endmenu
```
